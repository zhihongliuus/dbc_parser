VERSION "1.0"

NS_ :

BU_: ECU1 ECU2 ECU3

BO_ 100 EngineData: 8 ECU1
 SG_ EngineSpeed : 0|16@1- (0.1,0) [0|8000] "rpm" ECU2, ECU3
 SG_ EngineTemp : 16|8@1+ (1,0) [0|255] "C" ECU2

BO_ 200 VehicleData: 6 ECU2
 SG_ VehicleSpeed : 0|16@1+ (0.01,0) [0|300] "kph" ECU1, ECU3
 SG_ Acceleration : 16|16@1- (0.001,0) [-10|10] "g" ECU1

BO_ 300 BrakeData: 4 ECU3
 SG_ BrakePressure : 0|8@1+ (0.5,0) [0|100] "bar" ECU1, ECU2
 SG_ BrakeStatus : 8|1@1+ (1,0) [0|1] "" ECU1, ECU2

BO_ 400 MiscData: 8 ECU1
 SG_ IntelFormatSignal : 0|16@0- (1,0) [-1000|1000] "units" ECU2, ECU3
 SG_ MotorSignal : 16|16@1+ (0.1,0) [0|1000] "units" ECU2

CM_ BO_ 100 "Engine related data";
CM_ SG_ 100 EngineSpeed "Engine speed in revolutions per minute";
CM_ SG_ 100 EngineTemp "Engine temperature in celsius";
CM_ BO_ 200 "Vehicle motion data";
CM_ SG_ 200 VehicleSpeed "Vehicle speed in kilometers per hour";
CM_ SG_ 200 Acceleration "Vehicle acceleration in g-force";
CM_ BO_ 300 "Brake system data";
CM_ SG_ 300 BrakePressure "Brake pedal pressure in bar";
CM_ SG_ 300 BrakeStatus "Brake status: 0=off, 1=on";
CM_ BO_ 400 "Miscellaneous data with different byte orders";
CM_ SG_ 400 IntelFormatSignal "Example of Intel (Little Endian) byte order";
CM_ SG_ 400 MotorSignal "Example of Motorola (Big Endian) byte order";
